## meta-nezha-bsp/conf/machine/nezha-allwinner-d1-1g.conf
```bitbake
#@TYPE: Machine
#@NAME: nezha-allwinner-d1
#@SOC: Allwinner D1
#@DESCRIPTION: Machine configuration for Nezha board

require nezha-allwinner-d1.conf

RISCV_SBI_FDT = "sun20i-d1-nezha-1g.dtb"
UBOOT_DTB_BINARY = "sun20i-d1-nezha-1g.dtb"
KERNEL_DEVICETREE = "allwinner/sun20i-d1-nezha-1g.dtb"
```

## meta-nezha-distro/conf/distro/nezha.conf
```bitbake
require conf/distro/poky.conf

DISTRO = "nezha"

# distro name
DISTRO_NAME = "Distro for Nezha Allwinner D1 board (#KSON)"
DISTRO_VERSION = "1.0.0"
SDK_VENDOR = "-nezhasdk"

MAINTAINER = "Cezary Sobczak <cezary.sobczak98@gmail.com>"

TARGET_VENDOR = "-nezha"

DISTRO_FEATURES = "${DISTRO_FEATURES_DEFAULT} systemd"

# explictely use systemd and disable sysvinit completely
VIRTUAL-RUNTIME_init_manager = "systemd"
VIRTUAL-RUNTIME_initscripts = ""
VIRTUAL-RUNTIME_syslog = ""
DISTRO_FEATURES_BACKFILL_CONSIDERED += "sysvinit pulseaudio"

IMAGE_FSTYPES = "wic.gz wic.bmap"

# Use 'haveged' instead 'rng-tools' due to 'SIGSEGV' error during start 'rngd'
PACKAGE_EXCLUDE:append = "rng-tools"
IMAGE_INSTALL:append = "haveged"
```

## meta-nezha-distro/conf/layer.conf
```bitbake
# We have a conf and classes directory, add to BBPATH
BBPATH .= ":${LAYERDIR}"

# We have recipes-* directories, add to BBFILES
BBFILES += "${LAYERDIR}/recipes-*/*/*.bb ${LAYERDIR}/recipes-*/*/*.bbappend"

BBFILE_COLLECTIONS += "nezha-distro"
BBFILE_PATTERN_nezha-distro = "^${LAYERDIR}/"
BBFILE_PRIORITY_nezha-distro = "1"

# This should only be incremented on significant changes that will
# cause compatibility issues with other layers
LAYERVERSION:nezha-distro = "1"

LAYERDEPENDS:nezha-distro = " \
    core \
    openembedded-layer \
    "

LAYERSERIES_COMPAT_nezha-distro = "kirkstone master"
```
